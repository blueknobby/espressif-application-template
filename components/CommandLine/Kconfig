## components/CommandLine/Kconfig
```kconfig
#
# SPDX-License-Identifier: MIT
#

menu "App Command Line Processor Options"

    config APP_COMMAND_STACK_SIZE
        int "Allocated stack size for command line task"
        default 5120
        help
	    Allocated stack size for command line task

endmenu
```

## components/Logger/Kconfig
```kconfig
menu "Application Logger Details"

    config APP_LOGGER_STACK_SIZE
        int "Allocated stack size for Logger task"
        default 4096
        help
            Allocated stack size for Logger task

endmenu
```

## components/PilotLight/Kconfig
```kconfig
#
# SPDX-License-Identifier: MIT
#


menu "Hardware Pilot Light HW Configuration"

    config HW_HAVE_PILOT_LIGHT
    	bool "Blink a pilot light (LED/Neopixel)"
	default n
	help
	    Configure a task that blinks a pilot light LED

    config HW_PILOT_LIGHT_GPIO
        int "Pilot Light GPIO pin"
	depends on HW_HAVE_PILOT_LIGHT
        range 0 48 if HW_HAVE_PILOT_LIGHT
	default 8
        help
            GPIO pin assigned as pilot light

    config HW_PILOT_LIGHT_IS_NEOPIXEL
        bool "Use onboard NeoPixel for pilot light"
	depends on HW_HAVE_PILOT_LIGHT
	default n
	help
	    Enables use of the NeoPixel (controlled at the gpio pin HW_PILOT_LIGHT_GPIO)

    config APP_PILOT_LIGHT_STACK_SIZE
        int "Allocated stack size for pilotLight task"
	depends on HW_HAVE_PILOT_LIGHT
        default 3300
        help
            Allocated stack size for pilotLight task


    config APP_PILOT_LIGHT_COMMAND
        bool "Enable the 'pilot' command to set pilot light timings"
	depends on HW_HAVE_PILOT_LIGHT
	default y
	help
	    Enable the console 'pilot' command to set on/off times

    config APP_PILOT_LIGHT_ON_TIME
        int "Pilot Light ON time (in ms)"
	depends on HW_HAVE_PILOT_LIGHT
	default 250

    config APP_PILOT_LIGHT_OFF_TIME
        int "Pilot Light OFF time (in ms)"
	depends on HW_HAVE_PILOT_LIGHT
	default 750


endmenu
```

## components/PilotLight/Kconfig.new
```kconfig
menu "Pilot Light HW Configuration"

    config HW_PILOT_LIGHT_GPIO
        int "Pilot Light GPIO pin"
        default 21 if BKT_0
    default 42 if BKT_1
        range 0 48
        help
            GPIO pin assigned as pilot light

    config BKT_PILOT_LIGHT_STACK_SIZE
        int "Allocated stack size for pilotLight task"
        default 3072
        help
            Allocated stack size for pilotLight task


    config BKT_PILOT_LIGHT_IS_NEOPIXEL
        bool "Use onboard NeoPixel for pilot light"
    default n if BKT_0
    default y if BKT_1
    help
        Enables use of the NeoPixel (controlled at the gpio pin HW_PILOT_LIGHT_GPIO)

    config BKT_PILOT_LIGHT_COMMAND
        bool "Enable the 'pilot' command to set pilot light timings"
    default y
    help
        Enable the console 'pilot' command to set on/off times

endmenu
```

## main/Kconfig
```kconfig
menu "Application Heap Debug Options"

    config APP_RUN_HEAP_INTEGRITY_CHECK
        bool "Run heap integrity check in the main loop"
        default n
        help
            Run the heap integrity check in the main loop

    config APP_HEAP_INTEGRITY_CHECK_INTERVAL
        int "Run the heap integrity check every this many seconds"
	depends on APP_RUN_HEAP_INTEGRITY_CHECK
	default 5
	help
	    If APP_RUN_HEAP_INTEGRITY_CHECK=y, delay this many seconds between invocations

    config APP_PRINT_HEAP_INFO
        bool "Show heap info in the main loop"
        default n
        help
            Print heap info in the main loop

    config APP_PRINT_HEAP_INFO_INTERVAL
        int "Display the heap info every this many seconds"
	depends on APP_PRINT_HEAP_INFO
	default 60
	help
	    If APP_PRINT_HEAP_INFO=y, delay this many seconds between heap print


endmenu
```

## sdkconfig.defaults
```kconfig
#
# SPDX-License-Identifier: MIT
#
#
#
# These values are important to the application or are generic to
# ESP-IDF itself.
#
# Other settings will use the defaults as provided by the ESP IDF
#
#

# Heap Debugging
#CONFIG_APP_RUN_HEAP_INTEGRITY_CHECK=y
#CONFIG_APP_PRINT_HEAP_INFO=y

CONFIG_HEAP_TRACING=y
CONFIG_HEAP_TRACING_STACK_DEPTH=2
CONFIG_HEAP_TASK_TRACKING=y
CONFIG_HEAP_ABORT_WHEN_ALLOCATION_FAILS=y

CONFIG_HEAP_POISONING_COMPREHENSIVE=y
CONFIG_HEAP_TRACING_STANDALONE=y

CONFIG_ESP_MAIN_TASK_STACK_SIZE=6120
CONFIG_ESP_SYSTEM_EVENT_TASK_STACK_SIZE=6120

CONFIG_COMPILER_CXX_EXCEPTIONS=y
CONFIG_COMPILER_CXX_EXCEPTIONS_EMG_POOL_SIZE=0

CONFIG_COMPILER_STACK_CHECK_MODE_ALL=y
CONFIG_COMPILER_STACK_CHECK=y

CONFIG_ESP_EVENT_LOOP_PROFILING=y

CONFIG_FREERTOS_USE_TRACE_FACILITY=y
CONFIG_FREERTOS_USE_STATS_FORMATTING_FUNCTIONS=y
CONFIG_FREERTOS_VTASKLIST_INCLUDE_COREID=y

CONFIG_FREERTOS_GENERATE_RUN_TIME_STATS=y
CONFIG_FREERTOS_RUN_TIME_STATS_USING_ESP_TIMER=y

CONFIG_MBEDTLS_INTERNAL_MEM_ALLOC=y
```

## sdkconfig.defaults.esp32c3
```kconfig
#
# SPDX-License-Identifier: MIT
#
#
# These values are important to the application when running on the ESP32-C3 based boards
#
# Other settings will use the defaults as provided by the ESP IDF in sdkconfig.defaults
#
#

CONFIG_ESPTOOLPY_FLASHSIZE_4MB=y
CONFIG_ESPTOOLPY_FLASHSIZE="4MB"

CONFIG_PARTITION_TABLE_CUSTOM=y
CONFIG_PARTITION_TABLE_CUSTOM_FILENAME="partitions/4MB.csv"

# set up for the ESP32-C3-DevKitC
CONFIG_HW_HAVE_PILOT_LIGHT=y
CONFIG_HW_PILOT_LIGHT_GPIO=8
CONFIG_HW_PILOT_LIGHT_IS_NEOPIXEL=y
CONFIG_APP_PILOT_LIGHT_STACK_SIZE=3300

#
# on ESP32C3 we default to using the USB Serial/JTAG interface
#
CONFIG_ESP_CONSOLE_USB_SERIAL_JTAG=y
CONFIG_ESP_CONSOLE_SECONDARY_NONE=y
CONFIG_ESP_CONSOLE_MULTIPLE_UART=y
CONFIG_ESP_CONSOLE_UART_NUM=-1
```

## sdkconfig.defaults.esp32s3
```kconfig
#
# SPDX-License-Identifier: MIT
#
#
# These values are important to the application when running on the ESP32-S3 based boards
#
# Other settings will use the defaults as provided by the ESP IDF in sdkconfig.defaults
#
#

CONFIG_ESPTOOLPY_FLASHSIZE_8MB=y
CONFIG_ESPTOOLPY_FLASHSIZE="8MB"

CONFIG_PARTITION_TABLE_CUSTOM=y
CONFIG_PARTITION_TABLE_CUSTOM_FILENAME="partitions/8MB.csv"

#
# on ESP32S3 we default to using the USB Serial/JTAG interface
#
CONFIG_ESP_CONSOLE_USB_SERIAL_JTAG=y
CONFIG_ESP_CONSOLE_SECONDARY_NONE=y
CONFIG_ESP_CONSOLE_MULTIPLE_UART=y
CONFIG_ESP_CONSOLE_UART_NUM=-1

CONFIG_SPIRAM_SUPPORT=y
CONFIG_SPIRAM=y
CONFIG_SPIRAM_TYPE_AUTO=y
CONFIG_SPIRAM_USE_MALLOC=y
CONFIG_SPIRAM_MALLOC_ALWAYSINTERNAL=4
CONFIG_SPIRAM_ALLOW_BSS_SEG_EXTERNAL_MEMORY=y
CONFIG_SPIRAM_ALLOW_STACK_EXTERNAL_MEMORY=y
```
